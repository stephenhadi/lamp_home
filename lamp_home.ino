#include <avr/sleep.h>
#include <avr/power.h>

// Servo - Version: Latest 
#include <Servo.h>
volatile long lastWakeUp = millis();
volatile long called = 0;


/*

*/

Servo testing;
Servo below;
String incomingValue="";
void setup() {
  testing.attach(9);
  below.attach(7);
  testing.write(50);
  below.write(40);
  pinMode(LED_BUILTIN, OUTPUT);
  Serial.begin(9600);
  pinMode(2,INPUT_PULLUP);  
  digitalWrite(LED_BUILTIN,HIGH);
  //DISABLE ADC
}
void clean(){
  while(Serial.available()){
    char c = Serial.read();
  }
}

void loop() {
  Serial.println("loop start");
  digitalWrite(LED_BUILTIN,HIGH);
  delay(500);
  long timeNow = millis();
  incomingValue = "";
  while(Serial.available()){
    delay(50);
    char c = Serial.read();
    incomingValue +=c;   
  }
  incomingValue.trim();
  Serial.println(incomingValue);
  if(incomingValue.equals("off")){
    Serial.println("lights on");
    servoMove(1);      
    clean();  
    sleepYo();
  }
  else if(incomingValue.equals("on")){
    Serial.println("shut down");
    servoMove(0);      
    clean();  
    sleepYo();
  }
  
  
  if(timeNow-lastWakeUp > 3000 || timeNow-lastWakeUp < 0){
    lastWakeUp = millis();
    clean();
    sleepYo();
  }
  digitalWrite(LED_BUILTIN,LOW);
  delay(500);
}

void sleepYo(){
  noInterrupts();
 
  digitalWrite(LED_BUILTIN,LOW);
  delay(1000);
  sleep_enable();
  delay(100);
  attachInterrupt(0,wakeUp,HIGH);
  set_sleep_mode(SLEEP_MODE_PWR_DOWN);
  Serial.flush();
  called = 0;
  power_all_disable();   
  interrupts();  
  sleep_cpu();
  power_all_enable();
  sleep_disable();
  delay(2000);
  lastWakeUp = millis();  
}

void wakeUp(){
  power_all_enable();
  called = called+1;
  detachInterrupt(0);
}

void servoMove(int servoState){
  if(servoState == 1){
    
    testing.write(20);
    delay(100);
    testing.write(50);
    
  }
  else if(servoState == 0){
    below.write(180);
    delay(100);
    below.write(50);
  }
}

